## components/mqtt_producer/Kconfig.projbuild
```kconfig
menu "MQTT Project Configuration"

    config MQTT_BROKER_URL
        string "Broker URL"
        default "mqtt://192.168.1.28:1883"
        help
            URL of the broker to connect to
    config MQTT_TOPIC
        string "Topic"
        default "liwaisi-iot/general_temp_sensor"
        help
            Topic to publish messages to
    config MQTT_USERNAME
        string "Username"
        default ""
        help
            Username to connect to the broker
    config MQTT_PASSWORD
        string "Password"
        default ""
        help
            Password to connect to the broker
endmenu
```
